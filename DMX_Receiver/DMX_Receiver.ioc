# file: DMX_Receiver.ioc
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###############################################################################
## STM32CubeMX Project Configuration File
## Project: DMX_Receiver
###############################################################################
# Microcontroller -------------------------------------------------------------
Mcu.Name=STM32F103C8Tx
Mcu.Family=STM32F1
Mcu.SubFamily=STM32F103
Mcu.Package=LQFP48
# RCC ------------------------------------------------------------------------
RCC.Mode=HSE+PLL
RCC.HSE_VALUE=8000000
RCC.PLLSource=HSE
RCC.PLLMul=PLL_MUL9
RCC.SYSCLKFreq_VALUE=72000000
# USART1 Configuration --------------------------------------------------------
USART1.VirtualMode=Asynchronous
USART1.BaudRate=250000
USART1.WordLength=UART_WORDLENGTH_8B
USART1.Parity=UART_PARITY_NONE
USART1.StopBits=UART_STOPBITS_2
USART1.InterruptEnable=USART1_IRQn
# TIM2 Configuration ----------------------------------------------------------
TIM2.Channel-1=PWM Generation1 CH1
TIM2.Prescaler=71
TIM2.Period=255
# GPIO Configuration ----------------------------------------------------------
PA0.Mode=PWM Generation1 CH1
PA10.Mode=USART1_RX
# NVIC ------------------------------------------------------------------------
NVIC.0=USART1_IRQn,5,0,1,0,0
# Project ---------------------------------------------------------------------
PMS.ProjectName=DMX_Receiver
PMS.Toolchain=STM32CubeIDE

// file: Core/Src/main.c
/* USER CODE BEGIN Header */
/**
  ******************************************************************************
  * @file           : main.c
  * @brief          : Main program body for DMX Receiver demo (HAL only)
  ******************************************************************************
  */
/* USER CODE END Header */

#include "main.h"

/* USER CODE BEGIN Includes */
#include "dmx.h"
/* USER CODE END Includes */

/* USER CODE BEGIN PD */
#define DMX_LED_CHANNEL 2u
/* USER CODE END PD */

TIM_HandleTypeDef htim2;
UART_HandleTypeDef huart1;

void SystemClock_Config(void);
static void MX_GPIO_Init(void);
static void MX_TIM2_Init(void);
static void MX_USART1_UART_Init(void);

int main(void)
{
  /* MCU Configuration--------------------------------------------------------*/
  HAL_Init();
  SystemClock_Config();

  MX_GPIO_Init();
  MX_TIM2_Init();
  MX_USART1_UART_Init();

  /* USER CODE BEGIN 2 */
  HAL_TIM_PWM_Start(&htim2, TIM_CHANNEL_1);
  DMX_Init(&huart1);
  /* USER CODE END 2 */

  while (1)
  {
    /* USER CODE BEGIN WHILE */
    uint8_t level = DMX_GetChannelLevel(DMX_LED_CHANNEL);
    __HAL_TIM_SET_COMPARE(&htim2, TIM_CHANNEL_1, level);
    HAL_Delay(5);
    /* USER CODE END WHILE */
  }
}

void SystemClock_Config(void)
{
  /* USER CODE BEGIN SysInit */
  /* This function will be fully generated by STM32CubeMX. */
  /* USER CODE END SysInit */
}

/* TIM2 init function */
static void MX_TIM2_Init(void)
{

  htim2.Instance = TIM2;
  htim2.Init.Prescaler = 71;
  htim2.Init.CounterMode = TIM_COUNTERMODE_UP;
  htim2.Init.Period = 255;
  htim2.Init.ClockDivision = TIM_CLOCKDIVISION_DIV1;
  if (HAL_TIM_PWM_Init(&htim2) != HAL_OK)
  {
    Error_Handler();
  }
  /* USER CODE BEGIN TIM2_Init 2 */
  /* Channel configuration will be done by CubeMX */
  /* USER CODE END TIM2_Init 2 */
}

/* USART1 init function */
static void MX_USART1_UART_Init(void)
{

  huart1.Instance = USART1;
  huart1.Init.BaudRate = 250000;
  huart1.Init.WordLength = UART_WORDLENGTH_8B;
  huart1.Init.StopBits = UART_STOPBITS_2;
  huart1.Init.Parity = UART_PARITY_NONE;
  huart1.Init.Mode = UART_MODE_RX;
  huart1.Init.HwFlowCtl = UART_HWCONTROL_NONE;
  huart1.Init.OverSampling = UART_OVERSAMPLING_16;
  if (HAL_UART_Init(&huart1) != HAL_OK)
  {
    Error_Handler();
  }
}

static void MX_GPIO_Init(void)
{
  /* GPIO Ports Clock Enable */
  __HAL_RCC_GPIOA_CLK_ENABLE();
}

/* USER CODE BEGIN 4 */
/* Additional user functions can be placed here. */
/* USER CODE END 4 */

void Error_Handler(void)
{
  __disable_irq();
  while (1) {}
}
